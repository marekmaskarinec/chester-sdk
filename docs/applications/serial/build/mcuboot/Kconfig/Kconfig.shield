## docs/applications/serial/build/mcuboot/Kconfig/Kconfig.shield
```kconfig
osource "/home/marek/dev/hio/chester-sdk/chester/boards/shields/*/Kconfig.shield"
osource "/home/marek/dev/hio/chester-sdk/nrf/boards/shields/*/Kconfig.shield"
```

## docs/samples/asp/build/Kconfig/arch/Kconfig
```kconfig
# Load Zephyr Arch Kconfig descriptions.
osource "/home/marek/dev/hio/chester-sdk/zephyr/arch/x86/Kconfig"
osource "/home/marek/dev/hio/chester-sdk/zephyr/arch/xtensa/Kconfig"
osource "/home/marek/dev/hio/chester-sdk/zephyr/arch/sparc/Kconfig"
osource "/home/marek/dev/hio/chester-sdk/zephyr/arch/riscv/Kconfig"
osource "/home/marek/dev/hio/chester-sdk/zephyr/arch/posix/Kconfig"
osource "/home/marek/dev/hio/chester-sdk/zephyr/arch/nios2/Kconfig"
osource "/home/marek/dev/hio/chester-sdk/zephyr/arch/mips/Kconfig"
osource "/home/marek/dev/hio/chester-sdk/zephyr/arch/arm64/Kconfig"
osource "/home/marek/dev/hio/chester-sdk/zephyr/arch/arm/Kconfig"
osource "/home/marek/dev/hio/chester-sdk/zephyr/arch/arc/Kconfig"
```

## docs/samples/asp/build/Kconfig/soc/Kconfig
```kconfig
# Load Zephyr SoC Kconfig descriptions.
osource "/home/marek/dev/hio/chester-sdk/zephyr/soc/xlnx/zynqmp/Kconfig"
osource "/home/marek/dev/hio/chester-sdk/zephyr/soc/xlnx/zynq7000/Kconfig"
osource "/home/marek/dev/hio/chester-sdk/zephyr/soc/xen/Kconfig"
osource "/home/marek/dev/hio/chester-sdk/zephyr/soc/ti/simplelink/Kconfig"
osource "/home/marek/dev/hio/chester-sdk/zephyr/soc/ti/lm3s6965/Kconfig"
osource "/home/marek/dev/hio/chester-sdk/zephyr/soc/ti/k3/Kconfig"
osource "/home/marek/dev/hio/chester-sdk/zephyr/soc/telink/tlsr/Kconfig"
osource "/home/marek/dev/hio/chester-sdk/zephyr/soc/starfive/jh71xx/Kconfig"
osource "/home/marek/dev/hio/chester-sdk/zephyr/soc/st/stm32/Kconfig"
osource "/home/marek/dev/hio/chester-sdk/zephyr/soc/snps/qemu_arc/Kconfig"
osource "/home/marek/dev/hio/chester-sdk/zephyr/soc/snps/nsim/arc_v/Kconfig"
osource "/home/marek/dev/hio/chester-sdk/zephyr/soc/snps/nsim/arc_classic/Kconfig"
osource "/home/marek/dev/hio/chester-sdk/zephyr/soc/snps/hsdk4xd/Kconfig"
osource "/home/marek/dev/hio/chester-sdk/zephyr/soc/snps/hsdk/Kconfig"
osource "/home/marek/dev/hio/chester-sdk/zephyr/soc/snps/emsk/Kconfig"
osource "/home/marek/dev/hio/chester-sdk/zephyr/soc/snps/emsdp/Kconfig"
osource "/home/marek/dev/hio/chester-sdk/zephyr/soc/snps/arc_iot/Kconfig"
osource "/home/marek/dev/hio/chester-sdk/zephyr/soc/silabs/Kconfig"
osource "/home/marek/dev/hio/chester-sdk/zephyr/soc/sifive/sifive_freedom/Kconfig"
osource "/home/marek/dev/hio/chester-sdk/zephyr/soc/sensry/Kconfig"
osource "/home/marek/dev/hio/chester-sdk/zephyr/soc/rockchip/Kconfig"
osource "/home/marek/dev/hio/chester-sdk/zephyr/soc/renode/riscv_virtual/Kconfig"
osource "/home/marek/dev/hio/chester-sdk/zephyr/soc/renode/cortex_r8_virtual/Kconfig"
osource "/home/marek/dev/hio/chester-sdk/zephyr/soc/renesas/smartbond/Kconfig"
osource "/home/marek/dev/hio/chester-sdk/zephyr/soc/renesas/rzt2m/Kconfig"
osource "/home/marek/dev/hio/chester-sdk/zephyr/soc/renesas/rcar/Kconfig"
osource "/home/marek/dev/hio/chester-sdk/zephyr/soc/renesas/ra/Kconfig"
osource "/home/marek/dev/hio/chester-sdk/zephyr/soc/raspberrypi/Kconfig"
osource "/home/marek/dev/hio/chester-sdk/zephyr/soc/quicklogic/eos_s3/Kconfig"
osource "/home/marek/dev/hio/chester-sdk/zephyr/soc/qemu/virt_riscv/Kconfig"
osource "/home/marek/dev/hio/chester-sdk/zephyr/soc/qemu/malta/Kconfig"
osource "/home/marek/dev/hio/chester-sdk/zephyr/soc/openisa/rv32m1/Kconfig"
osource "/home/marek/dev/hio/chester-sdk/zephyr/soc/nxp/s32/Kconfig"
osource "/home/marek/dev/hio/chester-sdk/zephyr/soc/nxp/rw/Kconfig"
osource "/home/marek/dev/hio/chester-sdk/zephyr/soc/nxp/mcx/Kconfig"
osource "/home/marek/dev/hio/chester-sdk/zephyr/soc/nxp/lpc/Kconfig"
osource "/home/marek/dev/hio/chester-sdk/zephyr/soc/nxp/layerscape/Kconfig"
osource "/home/marek/dev/hio/chester-sdk/zephyr/soc/nxp/kinetis/Kconfig"
osource "/home/marek/dev/hio/chester-sdk/zephyr/soc/nxp/imxrt/Kconfig"
osource "/home/marek/dev/hio/chester-sdk/zephyr/soc/nxp/imx/Kconfig"
osource "/home/marek/dev/hio/chester-sdk/zephyr/soc/nuvoton/numicro/Kconfig"
osource "/home/marek/dev/hio/chester-sdk/zephyr/soc/nuvoton/numaker/Kconfig"
osource "/home/marek/dev/hio/chester-sdk/zephyr/soc/nuvoton/npcx/Kconfig"
osource "/home/marek/dev/hio/chester-sdk/zephyr/soc/nuvoton/npcm/Kconfig"
osource "/home/marek/dev/hio/chester-sdk/zephyr/soc/nordic/Kconfig"
osource "/home/marek/dev/hio/chester-sdk/zephyr/soc/neorv32/Kconfig"
osource "/home/marek/dev/hio/chester-sdk/zephyr/soc/native/inf_clock/Kconfig"
osource "/home/marek/dev/hio/chester-sdk/zephyr/soc/microchip/miv/Kconfig"
osource "/home/marek/dev/hio/chester-sdk/zephyr/soc/microchip/mec/Kconfig"
osource "/home/marek/dev/hio/chester-sdk/zephyr/soc/mediatek/mtk_adsp/Kconfig"
osource "/home/marek/dev/hio/chester-sdk/zephyr/soc/lowrisc/opentitan/Kconfig"
osource "/home/marek/dev/hio/chester-sdk/zephyr/soc/litex/litex_vexriscv/Kconfig"
osource "/home/marek/dev/hio/chester-sdk/zephyr/soc/ite/ec/Kconfig"
osource "/home/marek/dev/hio/chester-sdk/zephyr/soc/intel/raptor_lake/Kconfig"
osource "/home/marek/dev/hio/chester-sdk/zephyr/soc/intel/lakemont/Kconfig"
osource "/home/marek/dev/hio/chester-sdk/zephyr/soc/intel/intel_socfpga_std/Kconfig"
osource "/home/marek/dev/hio/chester-sdk/zephyr/soc/intel/intel_socfpga/Kconfig"
osource "/home/marek/dev/hio/chester-sdk/zephyr/soc/intel/intel_niosv/Kconfig"
osource "/home/marek/dev/hio/chester-sdk/zephyr/soc/intel/intel_ish/Kconfig"
osource "/home/marek/dev/hio/chester-sdk/zephyr/soc/intel/intel_adsp/Kconfig"
osource "/home/marek/dev/hio/chester-sdk/zephyr/soc/intel/elkhart_lake/Kconfig"
osource "/home/marek/dev/hio/chester-sdk/zephyr/soc/intel/atom/Kconfig"
osource "/home/marek/dev/hio/chester-sdk/zephyr/soc/intel/apollo_lake/Kconfig"
osource "/home/marek/dev/hio/chester-sdk/zephyr/soc/intel/alder_lake/Kconfig"
osource "/home/marek/dev/hio/chester-sdk/zephyr/soc/infineon/cat3/Kconfig"
osource "/home/marek/dev/hio/chester-sdk/zephyr/soc/infineon/cat1b/Kconfig"
osource "/home/marek/dev/hio/chester-sdk/zephyr/soc/infineon/cat1a/Kconfig"
osource "/home/marek/dev/hio/chester-sdk/zephyr/soc/gd/gd32/Kconfig"
osource "/home/marek/dev/hio/chester-sdk/zephyr/soc/gaisler/leon3/Kconfig"
osource "/home/marek/dev/hio/chester-sdk/zephyr/soc/gaisler/gr716a/Kconfig"
osource "/home/marek/dev/hio/chester-sdk/zephyr/soc/espressif/Kconfig"
osource "/home/marek/dev/hio/chester-sdk/zephyr/soc/ene/kb1200/Kconfig"
osource "/home/marek/dev/hio/chester-sdk/zephyr/soc/efinix/sapphire/Kconfig"
osource "/home/marek/dev/hio/chester-sdk/zephyr/soc/cdns/xtensa_sample_controller/Kconfig"
osource "/home/marek/dev/hio/chester-sdk/zephyr/soc/cdns/dc233c/Kconfig"
osource "/home/marek/dev/hio/chester-sdk/zephyr/soc/brcm/bcmvk/Kconfig"
osource "/home/marek/dev/hio/chester-sdk/zephyr/soc/brcm/bcm2712/Kconfig"
osource "/home/marek/dev/hio/chester-sdk/zephyr/soc/brcm/bcm2711/Kconfig"
osource "/home/marek/dev/hio/chester-sdk/zephyr/soc/atmel/sam0/Kconfig"
osource "/home/marek/dev/hio/chester-sdk/zephyr/soc/atmel/sam/Kconfig"
osource "/home/marek/dev/hio/chester-sdk/zephyr/soc/aspeed/Kconfig"
osource "/home/marek/dev/hio/chester-sdk/zephyr/soc/arm/Kconfig"
osource "/home/marek/dev/hio/chester-sdk/zephyr/soc/arm/beetle/Kconfig"
osource "/home/marek/dev/hio/chester-sdk/zephyr/soc/andestech/Kconfig"
osource "/home/marek/dev/hio/chester-sdk/zephyr/soc/ambiq/Kconfig"
osource "/home/marek/dev/hio/chester-sdk/zephyr/soc/altr/zephyr_nios2f/Kconfig"
osource "/home/marek/dev/hio/chester-sdk/zephyr/soc/altr/qemu_nios2/Kconfig"
osource "/home/marek/dev/hio/chester-sdk/zephyr/soc/adi/max32/Kconfig"
```

## docs/samples/chester_x7/build/Kconfig/Kconfig.shield.defconfig
```kconfig
osource "/home/marek/dev/hio/chester-sdk/chester/boards/shields/*/Kconfig.defconfig"
osource "/home/marek/dev/hio/chester-sdk/nrf/boards/shields/*/Kconfig.defconfig"
```

## docs/samples/ctr_ble/build/ctr_ble/Kconfig/boards/Kconfig.defconfig
```kconfig
# Load Zephyr board defconfig descriptions.
osource "/home/marek/dev/hio/chester-sdk/chester/boards/hardwario/chester/Kconfig.defconfig"
```

## docs/samples/pt1000/build/Kconfig/boards/Kconfig.chester
```kconfig
# Load board Kconfig descriptions.
osource "/home/marek/dev/hio/chester-sdk/chester/boards/hardwario/chester/Kconfig.chester"
```
