## docs/samples/rfmux/build/rfmux/Kconfig/soc/Kconfig.tmp
```kconfig
# Load Zephyr SoC Kconfig descriptions.
osource "/home/marek/dev/hio/chester-sdk/zephyr/soc/xlnx/zynqmp/Kconfig"
osource "/home/marek/dev/hio/chester-sdk/zephyr/soc/xlnx/zynq7000/Kconfig"
osource "/home/marek/dev/hio/chester-sdk/zephyr/soc/xlnx/versalnet/Kconfig"
osource "/home/marek/dev/hio/chester-sdk/zephyr/soc/xlnx/versal2/Kconfig"
osource "/home/marek/dev/hio/chester-sdk/zephyr/soc/xlnx/versal/Kconfig"
osource "/home/marek/dev/hio/chester-sdk/zephyr/soc/xen/Kconfig"
osource "/home/marek/dev/hio/chester-sdk/zephyr/soc/wch/ch32v/Kconfig"
osource "/home/marek/dev/hio/chester-sdk/zephyr/soc/ti/simplelink/Kconfig"
osource "/home/marek/dev/hio/chester-sdk/zephyr/soc/ti/mspm0/Kconfig"
osource "/home/marek/dev/hio/chester-sdk/zephyr/soc/ti/lm3s6965/Kconfig"
osource "/home/marek/dev/hio/chester-sdk/zephyr/soc/ti/k3/Kconfig"
osource "/home/marek/dev/hio/chester-sdk/zephyr/soc/telink/tlsr/Kconfig"
osource "/home/marek/dev/hio/chester-sdk/zephyr/soc/starfive/jh71xx/Kconfig"
osource "/home/marek/dev/hio/chester-sdk/zephyr/soc/st/stm32/Kconfig"
osource "/home/marek/dev/hio/chester-sdk/zephyr/soc/snps/qemu_arc/Kconfig"
osource "/home/marek/dev/hio/chester-sdk/zephyr/soc/snps/nsim/arc_v/Kconfig"
osource "/home/marek/dev/hio/chester-sdk/zephyr/soc/snps/nsim/arc_classic/Kconfig"
osource "/home/marek/dev/hio/chester-sdk/zephyr/soc/snps/hsdk4xd/Kconfig"
osource "/home/marek/dev/hio/chester-sdk/zephyr/soc/snps/hsdk/Kconfig"
osource "/home/marek/dev/hio/chester-sdk/zephyr/soc/snps/emsk/Kconfig"
osource "/home/marek/dev/hio/chester-sdk/zephyr/soc/snps/emsdp/Kconfig"
osource "/home/marek/dev/hio/chester-sdk/zephyr/soc/snps/arc_iot/Kconfig"
osource "/home/marek/dev/hio/chester-sdk/zephyr/soc/silabs/Kconfig"
osource "/home/marek/dev/hio/chester-sdk/zephyr/soc/sifli/sf32/Kconfig"
osource "/home/marek/dev/hio/chester-sdk/zephyr/soc/sifive/sifive_freedom/Kconfig"
osource "/home/marek/dev/hio/chester-sdk/zephyr/soc/sensry/Kconfig"
osource "/home/marek/dev/hio/chester-sdk/zephyr/soc/rockchip/Kconfig"
osource "/home/marek/dev/hio/chester-sdk/zephyr/soc/renode/riscv_virtual/Kconfig"
osource "/home/marek/dev/hio/chester-sdk/zephyr/soc/renode/cortex_r8_virtual/Kconfig"
osource "/home/marek/dev/hio/chester-sdk/zephyr/soc/renesas/smartbond/Kconfig"
osource "/home/marek/dev/hio/chester-sdk/zephyr/soc/renesas/rz/Kconfig"
osource "/home/marek/dev/hio/chester-sdk/zephyr/soc/renesas/rx/Kconfig"
osource "/home/marek/dev/hio/chester-sdk/zephyr/soc/renesas/rcar/Kconfig"
osource "/home/marek/dev/hio/chester-sdk/zephyr/soc/renesas/ra/Kconfig"
osource "/home/marek/dev/hio/chester-sdk/zephyr/soc/realtek/ec/Kconfig"
osource "/home/marek/dev/hio/chester-sdk/zephyr/soc/realtek/ameba/Kconfig"
osource "/home/marek/dev/hio/chester-sdk/zephyr/soc/raspberrypi/rpi_pico/Kconfig"
osource "/home/marek/dev/hio/chester-sdk/zephyr/soc/quicklogic/eos_s3/Kconfig"
osource "/home/marek/dev/hio/chester-sdk/zephyr/soc/qemu/virt_riscv/Kconfig"
osource "/home/marek/dev/hio/chester-sdk/zephyr/soc/qemu/malta/Kconfig"
osource "/home/marek/dev/hio/chester-sdk/zephyr/soc/openisa/rv32m1/Kconfig"
osource "/home/marek/dev/hio/chester-sdk/zephyr/soc/openhwgroup/cva6/Kconfig"
osource "/home/marek/dev/hio/chester-sdk/zephyr/soc/oct/osd32mp15x/Kconfig"
osource "/home/marek/dev/hio/chester-sdk/zephyr/soc/nxp/s32/Kconfig"
osource "/home/marek/dev/hio/chester-sdk/zephyr/soc/nxp/rw/Kconfig"
osource "/home/marek/dev/hio/chester-sdk/zephyr/soc/nxp/mcx/Kconfig"
osource "/home/marek/dev/hio/chester-sdk/zephyr/soc/nxp/lpc/Kconfig"
osource "/home/marek/dev/hio/chester-sdk/zephyr/soc/nxp/layerscape/Kconfig"
osource "/home/marek/dev/hio/chester-sdk/zephyr/soc/nxp/kinetis/Kconfig"
osource "/home/marek/dev/hio/chester-sdk/zephyr/soc/nxp/imxrt/Kconfig"
osource "/home/marek/dev/hio/chester-sdk/zephyr/soc/nxp/imx/Kconfig"
osource "/home/marek/dev/hio/chester-sdk/zephyr/soc/nuvoton/numicro/Kconfig"
osource "/home/marek/dev/hio/chester-sdk/zephyr/soc/nuvoton/numaker/Kconfig"
osource "/home/marek/dev/hio/chester-sdk/zephyr/soc/nuvoton/npcx/Kconfig"
osource "/home/marek/dev/hio/chester-sdk/zephyr/soc/nuvoton/npcm/Kconfig"
osource "/home/marek/dev/hio/chester-sdk/zephyr/soc/nordic/Kconfig"
osource "/home/marek/dev/hio/chester-sdk/zephyr/soc/neorv32/Kconfig"
osource "/home/marek/dev/hio/chester-sdk/zephyr/soc/native/inf_clock/Kconfig"
osource "/home/marek/dev/hio/chester-sdk/zephyr/soc/microchip/sam/sama7/Kconfig"
osource "/home/marek/dev/hio/chester-sdk/zephyr/soc/microchip/sam/sam_d5x_e5x/Kconfig"
osource "/home/marek/dev/hio/chester-sdk/zephyr/soc/microchip/pic64/Kconfig"
osource "/home/marek/dev/hio/chester-sdk/zephyr/soc/microchip/pic32c/pic32cz_ca/Kconfig"
osource "/home/marek/dev/hio/chester-sdk/zephyr/soc/microchip/pic32c/pic32cx_sg/Kconfig"
osource "/home/marek/dev/hio/chester-sdk/zephyr/soc/microchip/pic32c/pic32cm_jh/Kconfig"
osource "/home/marek/dev/hio/chester-sdk/zephyr/soc/microchip/miv/Kconfig"
osource "/home/marek/dev/hio/chester-sdk/zephyr/soc/microchip/mec/Kconfig"
osource "/home/marek/dev/hio/chester-sdk/zephyr/soc/mediatek/mt8xxx/Kconfig"
osource "/home/marek/dev/hio/chester-sdk/zephyr/soc/lowrisc/opentitan/Kconfig"
osource "/home/marek/dev/hio/chester-sdk/zephyr/soc/litex/litex_vexriscv/Kconfig"
osource "/home/marek/dev/hio/chester-sdk/zephyr/soc/ite/ec/Kconfig"
osource "/home/marek/dev/hio/chester-sdk/zephyr/soc/intel/wildcat_lake/Kconfig"
osource "/home/marek/dev/hio/chester-sdk/zephyr/soc/intel/raptor_lake/Kconfig"
osource "/home/marek/dev/hio/chester-sdk/zephyr/soc/intel/panther_lake/Kconfig"
osource "/home/marek/dev/hio/chester-sdk/zephyr/soc/intel/lakemont/Kconfig"
osource "/home/marek/dev/hio/chester-sdk/zephyr/soc/intel/intel_socfpga_std/Kconfig"
osource "/home/marek/dev/hio/chester-sdk/zephyr/soc/intel/intel_socfpga/Kconfig"
osource "/home/marek/dev/hio/chester-sdk/zephyr/soc/intel/intel_niosv/Kconfig"
osource "/home/marek/dev/hio/chester-sdk/zephyr/soc/intel/intel_ish/Kconfig"
osource "/home/marek/dev/hio/chester-sdk/zephyr/soc/intel/intel_adsp/Kconfig"
osource "/home/marek/dev/hio/chester-sdk/zephyr/soc/intel/elkhart_lake/Kconfig"
osource "/home/marek/dev/hio/chester-sdk/zephyr/soc/intel/atom/Kconfig"
osource "/home/marek/dev/hio/chester-sdk/zephyr/soc/intel/apollo_lake/Kconfig"
osource "/home/marek/dev/hio/chester-sdk/zephyr/soc/intel/alder_lake/Kconfig"
osource "/home/marek/dev/hio/chester-sdk/zephyr/soc/infineon/psoc4/Kconfig"
osource "/home/marek/dev/hio/chester-sdk/zephyr/soc/infineon/edge/Kconfig"
osource "/home/marek/dev/hio/chester-sdk/zephyr/soc/infineon/cat3/Kconfig"
osource "/home/marek/dev/hio/chester-sdk/zephyr/soc/infineon/cat1c/Kconfig"
osource "/home/marek/dev/hio/chester-sdk/zephyr/soc/infineon/cat1b/Kconfig"
osource "/home/marek/dev/hio/chester-sdk/zephyr/soc/infineon/cat1a/Kconfig"
osource "/home/marek/dev/hio/chester-sdk/zephyr/soc/gd/gd32/Kconfig"
osource "/home/marek/dev/hio/chester-sdk/zephyr/soc/gaisler/leon3/Kconfig"
osource "/home/marek/dev/hio/chester-sdk/zephyr/soc/gaisler/gr716a/Kconfig"
osource "/home/marek/dev/hio/chester-sdk/zephyr/soc/focaltech/Kconfig"
osource "/home/marek/dev/hio/chester-sdk/zephyr/soc/espressif/Kconfig"
osource "/home/marek/dev/hio/chester-sdk/zephyr/soc/ene/kb1200/Kconfig"
osource "/home/marek/dev/hio/chester-sdk/zephyr/soc/ene/kb106x/Kconfig"
osource "/home/marek/dev/hio/chester-sdk/zephyr/soc/elan/em32f967/Kconfig"
osource "/home/marek/dev/hio/chester-sdk/zephyr/soc/egis/Kconfig"
osource "/home/marek/dev/hio/chester-sdk/zephyr/soc/efinix/sapphire/Kconfig"
osource "/home/marek/dev/hio/chester-sdk/zephyr/soc/cdns/xtensa_sample_controller/Kconfig"
osource "/home/marek/dev/hio/chester-sdk/zephyr/soc/cdns/sample_controller32/Kconfig"
osource "/home/marek/dev/hio/chester-sdk/zephyr/soc/cdns/dc233c/Kconfig"
osource "/home/marek/dev/hio/chester-sdk/zephyr/soc/brcm/bcmvk/Kconfig"
osource "/home/marek/dev/hio/chester-sdk/zephyr/soc/brcm/bcm2712/Kconfig"
osource "/home/marek/dev/hio/chester-sdk/zephyr/soc/brcm/bcm2711/Kconfig"
osource "/home/marek/dev/hio/chester-sdk/zephyr/soc/blackberry/qnxhv_vm/Kconfig"
osource "/home/marek/dev/hio/chester-sdk/zephyr/soc/bflb/Kconfig"
osource "/home/marek/dev/hio/chester-sdk/zephyr/soc/atmel/sam0/Kconfig"
osource "/home/marek/dev/hio/chester-sdk/zephyr/soc/atmel/sam/Kconfig"
osource "/home/marek/dev/hio/chester-sdk/zephyr/soc/aspeed/Kconfig"
osource "/home/marek/dev/hio/chester-sdk/zephyr/soc/arm/Kconfig"
osource "/home/marek/dev/hio/chester-sdk/zephyr/soc/arm/beetle/Kconfig"
osource "/home/marek/dev/hio/chester-sdk/zephyr/soc/antmicro/myra/Kconfig"
osource "/home/marek/dev/hio/chester-sdk/zephyr/soc/andestech/Kconfig"
osource "/home/marek/dev/hio/chester-sdk/zephyr/soc/amd/acp_6_0/Kconfig"
osource "/home/marek/dev/hio/chester-sdk/zephyr/soc/ambiq/Kconfig"
osource "/home/marek/dev/hio/chester-sdk/zephyr/soc/allwinner/sun8i_h3/Kconfig"
osource "/home/marek/dev/hio/chester-sdk/zephyr/soc/aesc/Kconfig"
osource "/home/marek/dev/hio/chester-sdk/zephyr/soc/adi/max32/Kconfig"
osource "/home/marek/dev/hio/chester-sdk/nrf/soc/sercomm/nrf91/Kconfig"
osource "/home/marek/dev/hio/chester-sdk/nrf/soc/nordic/Kconfig"
```

## docs/tests/subsys/ctr_cloud/build/Kconfig/boards/Kconfig.qemu_cortex_m3.tmp
```kconfig
# Load board Kconfig descriptions.
osource "/home/marek/dev/hio/chester-sdk/zephyr/boards/qemu/cortex_m3/Kconfig.qemu_cortex_m3"
```

## docs/tests/subsys/ctr_cloud/build/Kconfig/boards/Kconfig.sysbuild.tmp
```kconfig
# Load Sysbuild board Kconfig descriptions.
osource "/home/marek/dev/hio/chester-sdk/zephyr/boards/qemu/cortex_m3/Kconfig.sysbuild"
```

## docs/tests/subsys/ctr_cloud/build/ctr_cloud/Kconfig/boards/Kconfig.defconfig
```kconfig
# Load Zephyr board defconfig descriptions.
osource "/home/marek/dev/hio/chester-sdk/zephyr/boards/qemu/cortex_m3/Kconfig.defconfig"
```

## docs/tests/subsys/ctr_lte_v2/build/Kconfig/boards/Kconfig
```kconfig
# Load Zephyr board Kconfig descriptions.
osource "/home/marek/dev/hio/chester-sdk/zephyr/boards/native/native_sim/Kconfig"
```

## docs/tests/subsys/ctr_lte_v2/build/ctr_lte_v2/Kconfig/boards/Kconfig.native_sim
```kconfig
# Load board Kconfig descriptions.
osource "/home/marek/dev/hio/chester-sdk/zephyr/boards/native/native_sim/Kconfig.native_sim"
```

## docs/tests/subsys/ctr_trace/build/ctr_trace/Kconfig/boards/Kconfig.sysbuild.tmp
```kconfig
# Load Sysbuild board Kconfig descriptions.
osource "/home/marek/dev/hio/chester-sdk/zephyr/boards/native/native_sim/Kconfig.sysbuild"
```
